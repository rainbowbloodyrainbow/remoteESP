## main/Kconfig.projbuild
```kconfig
menu "ESP32 remote chassis"

config CAR_MOTORS_ENABLE
    bool "Enable real motor output (lift wheels before enabling)"
    default y
    help
        Disabled still receives Twist and logs target/measured PPS. Enabling
        requires valid signs/limits and, in calibrated mode, measured geometry.

choice CAR_MAPPING
    prompt "Twist to wheel PPS mapping"
    default CAR_MAPPING_DIRECTION
config CAR_MAPPING_DIRECTION
    bool "Direction test: configurable PPS gains, no measured geometry"
config CAR_MAPPING_CALIBRATED
    bool "Physical differential drive: measured geometry required"
endchoice

config CAR_LINEAR_PPS_PER_MPS
    int "Direction mode: wheel PPS per unit linear.x"
    range 1 100000000
    default 10000
config CAR_TURN_PPS_PER_RAD_S
    int "Direction mode: wheel PPS per unit angular.z"
    range 1 100000000
    default 1000
config CAR_WHEEL_DIAMETER_MM
    int "Measured wheel diameter (mm, 0 = unknown)"
    range 0 1000
    default 0
config CAR_TRACK_MM
    int "Measured wheel center spacing (mm, 0 = unknown)"
    range 0 2000
    default 0
config CAR_TICKS_PER_REV
    int "Measured PCNT A-rising-edge ticks per wheel revolution (0 = unknown)"
    range 0 1000000
    default 0

config CAR_CMD_TIMEOUT_MS
    int "cmd_vel watchdog timeout (ms)"
    range 100 1000
    default 400
config CAR_PWM_LIMIT
    int "Absolute PWM limit in BOTH directions (10-bit, full scale 1023)"
    range 1 1023
    default 1023
config CAR_REV_STOP_PPS
    int "Reversal allowed below this measured absolute speed (PPS)"
    range 1 5000
    default 150
config CAR_REV_QUIET_MS
    int "Required continuous near-zero coast time before reversal (ms)"
    range 100 2000
    default 200
config CAR_LEFT_ENC_SIGN
    int "Left encoder sign (+1 or -1 only)"
    range -1 1
    default 1
config CAR_RIGHT_ENC_SIGN
    int "Right encoder sign (+1 or -1 only)"
    range -1 1
    default -1
config CAR_LEFT_MOTOR_SIGN
    int "Left motor sign (+1 or -1 only; independent of encoder sign)"
    range -1 1
    default 1
config CAR_RIGHT_MOTOR_SIGN
    int "Right motor sign (+1 or -1 only; independent of encoder sign)"
    range -1 1
    default 1

comment "Low-speed feedforward/deadzone must be measured; all default to zero"
config CAR_LEFT_DEAD_FWD
    int "Left forward deadzone feedforward PWM (must be <= PWM limit)"
    range 0 1023
    default 0
config CAR_LEFT_DEAD_REV
    int "Left reverse deadzone feedforward PWM (must be <= PWM limit)"
    range 0 1023
    default 0
config CAR_RIGHT_DEAD_FWD
    int "Right forward deadzone feedforward PWM (must be <= PWM limit)"
    range 0 1023
    default 0
config CAR_RIGHT_DEAD_REV
    int "Right reverse deadzone feedforward PWM (must be <= PWM limit)"
    range 0 1023
    default 0
config CAR_LEFT_FF_PWM_PER_KPPS
    int "Left feedforward PWM per 1000 PPS (symmetric slope)"
    range 0 1000
    default 0
config CAR_RIGHT_FF_PWM_PER_KPPS
    int "Right feedforward PWM per 1000 PPS (symmetric slope)"
    range 0 1000
    default 0
config CAR_LOG_PERIOD_MS
    int "Serial telemetry interval (ms)"
    range 100 10000
    default 1000

endmenu
```

## sdkconfig.defaults
```kconfig
CONFIG_IDF_TARGET="esp32"
CONFIG_MICRO_ROS_ESP_XRCE_DDS_MIDDLEWARE=y
CONFIG_MICRO_ROS_ESP_NETIF_WLAN=y
CONFIG_ESP_WIFI_SSID=""
CONFIG_ESP_WIFI_PASSWORD=""
CONFIG_MICRO_ROS_AGENT_IP="0.0.0.0"
CONFIG_MICRO_ROS_AGENT_PORT="8888"
CONFIG_CAR_MOTORS_ENABLE=y
CONFIG_CAR_PWM_LIMIT=1023
CONFIG_CAR_LINEAR_PPS_PER_MPS=10000
CONFIG_CAR_TURN_PPS_PER_RAD_S=1000
CONFIG_CAR_MAPPING_CALIBRATED=y
CONFIG_CAR_WHEEL_DIAMETER_TENTH_MM=473
CONFIG_CAR_TRACK_TENTH_MM=1334
CONFIG_CAR_TICKS_PER_REV=10200
CONFIG_FREERTOS_HZ=1000
CONFIG_ESP_MAIN_TASK_STACK_SIZE=4096
CONFIG_PARTITION_TABLE_CUSTOM=y
CONFIG_PARTITION_TABLE_CUSTOM_FILENAME="partitions.csv"
```
